## boards/shields/dactyl_manuform_6x6/Kconfig.defconfig
```kconfig
if SHIELD_DACTYL_MANUFORM_6X6_LEFT

config ZMK_KEYBOARD_NAME
    default "paul-dactyl"

config ZMK_SPLIT_ROLE_CENTRAL
    default y

config BT_MAX_CONN
    default 2

config BT_MAX_PAIRED
    default 2

config ZMK_SPLIT_BLE_CENTRAL_PERIPHERALS
    default 1

endif

if SHIELD_DACTYL_MANUFORM_6X6_DONGLE

config ZMK_KEYBOARD_NAME
    default "paul-dactyl"

config ZMK_SPLIT_ROLE_CENTRAL
    default y

config BT_MAX_CONN
    default 3

config BT_MAX_PAIRED
    default 3

config ZMK_SPLIT_BLE_CENTRAL_PERIPHERALS
    default 2

config ZMK_SPLIT_BLE_CENTRAL_BATTERY_LEVEL_FETCHING
    default y

config ZMK_DISPLAY
    default y

choice ZMK_DISPLAY_STATUS_SCREEN
    default ZMK_DISPLAY_STATUS_SCREEN_CUSTOM
endchoice

config ZMK_DISPLAY_STATUS_SCREEN_CUSTOM
    select LV_USE_LABEL
    select LV_USE_BAR
    select LV_USE_FLEX
    select LV_COLOR_SCREEN_TRANSP

choice ZMK_DISPLAY_WORK_QUEUE
    default ZMK_DISPLAY_WORK_QUEUE_DEDICATED
endchoice

config ZMK_DISPLAY_DEDICATED_THREAD_STACK_SIZE
    default 4096

choice ST7789V_PIXEL_FORMAT
    default ST7789V_RGB565
endchoice

config LV_Z_VDB_SIZE
    default 100

config LV_Z_MEM_POOL_SIZE
    default 10000

config LV_DPI_DEF
    default 261

config LV_Z_BITS_PER_PIXEL
    default 16

choice LV_COLOR_DEPTH
    default LV_COLOR_DEPTH_16
endchoice

config LV_COLOR_16_SWAP
    default y

config LV_DISP_DEF_REFR_PERIOD
    default 20

choice LV_FONT_DEFAULT
    default LV_FONT_DEFAULT_MONTSERRAT_20
endchoice

config PWM
    default y

config LED
    default y

config LV_USE_LINE
    default y

config LV_USE_IMG
    default y

endif

if SHIELD_DACTYL_MANUFORM_6X6_LEFT || SHIELD_DACTYL_MANUFORM_6X6_LEFT_PERIPHERAL || SHIELD_DACTYL_MANUFORM_6X6_RIGHT || SHIELD_DACTYL_MANUFORM_6X6_DONGLE

config ZMK_SPLIT
    default y

endif
```

## boards/shields/dactyl_manuform_6x6/Kconfig.shield
```kconfig
config SHIELD_DACTYL_MANUFORM_6X6_LEFT
    def_bool $(shields_list_contains,dactyl_manuform_6x6_left)

config SHIELD_DACTYL_MANUFORM_6X6_LEFT_PERIPHERAL
    def_bool $(shields_list_contains,dactyl_manuform_6x6_left_peripheral)

config SHIELD_DACTYL_MANUFORM_6X6_RIGHT
    def_bool $(shields_list_contains,dactyl_manuform_6x6_right)

config SHIELD_DACTYL_MANUFORM_6X6_DONGLE
    def_bool $(shields_list_contains,dactyl_manuform_6x6_dongle)

if SHIELD_DACTYL_MANUFORM_6X6_DONGLE

config DACTYL_MANUFORM_6X6_DISPLAY_FIXED_BRIGHTNESS
    int "Dactyl Manuform dongle display brightness"
    range 0 100
    default 80

endif
```
